## platform/arm/Kconfig
```kconfig
config ARM
	bool

source "platform/arm/ti/Kconfig"
source "platform/arm/stm32/Kconfig"
source "platform/arm/frdm/Kconfig"
```

## platform/arm/frdm/Kconfig
```kconfig
config FRDM
	bool
	select ARM
	select PLAT_HAS_GCC
	select PLAT_HAS_MALLOC
	select PLAT_HAS_SERIAL
	select BUFFERED_SERIAL
```

## platform/arm/stm32/Kconfig
```kconfig
config STM32
	bool
	select ARM
	select PLAT_HAS_GCC
	select PLAT_HAS_MALLOC
	select PLAT_HAS_GPIO
	select PLAT_HAS_SERIAL
	select PLAT_HAS_SPI
	select BUFFERED_SERIAL
	select GPIO

config STM32_USART_NO_IN_AF
	bool

config STM32_GPIO_API_LEGACY
	bool

config STM32_HAS_FSMC_LCD
	bool

config STM32F1XX
	bool
	select STM32
	select STM32_GPIO_API_LEGACY
	select STM32_USART_NO_IN_AF
	select STM32_HAS_FSMC_LCD

config STM32F103XX
	bool
	select STM32F1XX

config STM32F103RBT
	bool
	select STM32F103XX

config STM32F103VET6
	bool
	select STM32F103XX

config STM32F103RCT6
	bool
	select STM32F103XX

config STM32F3XX
	bool
	select STM32

config STM32F303XX
	bool
	select STM32F3XX

config STM32F4XX
	bool
	select STM32

config STM32F407XX
	bool
	select STM32F4XX
	select STM32_HAS_FSMC_LCD
	select PLAT_HAS_I2C
	select PLAT_HAS_USB
        select USB_DEVICE_QUIRK_SET_ADDR_IMM

config STM32F429XX
	bool
	select STM32F4XX

config STM32_FSMC_LCD
	bool "Support for FSMC connected ILI93XX LCD controller"
	depends on STM32_HAS_FSMC_LCD
	default y
```

## platform/arm/ti/Kconfig
```kconfig
config TI
        bool

config STELLARIS
	bool
	select ARM
	select TI
	select PLAT_HAS_GCC
	select PLAT_HAS_TI_CCS5
	select PLAT_HAS_GPIO
	select PLAT_HAS_SERIAL
	select BUFFERED_SERIAL
	select PLAT_HAS_SPI
	select PLAT_HAS_MALLOC

config TIVA_C
	bool
	select ARM
	select TI
	select PLAT_HAS_GCC
	select PLAT_HAS_GPIO
	select PLAT_HAS_SERIAL
	select BUFFERED_SERIAL
	select PLAT_HAS_SPI
	select PLAT_HAS_MALLOC

config CC3200
	bool
	select ARM
	select TI
	select PLAT_HAS_GCC
	select PLAT_HAS_SERIAL
	select BUFFERED_SERIAL
	select PLAT_HAS_MALLOC

config STELLARIS_ETH
	bool
	depends on STELLARIS && PLAT_HAS_EMBEDDED_ETH && NET
	select ETHERIF
	default y

config TIVA_C_EMAC
	bool
	depends on TIVA_C && PLAT_HAS_EMBEDDED_ETH && NET
	select ETHERIF
	default y

config TI_I2C_WAIT_FOR_BUSY_WAR
	bool
	
config LM3S6918
	bool
	select STELLARIS
	select PLAT_HAS_EMBEDDED_ETH

config LM3S6965
	bool
	select STELLARIS
	select PLAT_HAS_PWM
	select PLAT_HAS_EMBEDDED_ETH

config LM4F120XL
	bool
	select STELLARIS
	select PLAT_HAS_GPIO_INTERRUPTS
	select PLAT_HAS_I2C

config TM4C123G
	bool
	select TIVA_C
	select PLAT_HAS_I2C
	select PLAT_HAS_GPIO_INTERRUPTS

config TM4C1294
	bool
	select TIVA_C
	select PLAT_HAS_PWM
	select PLAT_HAS_EMBEDDED_ETH
	select PLAT_HAS_I2C
	select TI_I2C_WAIT_FOR_BUSY_WAR
```

## platform/avr8/Kconfig
```kconfig
config AVR8
        bool
	select PLAT_HAS_GCC
	select PLAT_HAS_GPIO
	select PLAT_HAS_MALLOC
	select PLAT_HAS_SERIAL
	select BUFFERED_SERIAL
        select PLAT_TICKS
	select 16_BIT

config ATMEGA328
        bool
        select AVR8
```

## platform/esp8266/Kconfig
```kconfig
config ESP8266
        bool
	select PLAT_HAS_GCC
	select PLAT_HAS_OWN_MALLOC
	select PLAT_HAS_SERIAL
	select BUFFERED_SERIAL
        select PLAT_TICKS

config ESP8266_WIFI
        bool "Wi-Fi Support"
        depends on NET
```

## platform/msp430/Kconfig
```kconfig
config MSP430
	bool
	select PLAT_HAS_TI_CCS5
        select PLAT_HAS_GCC
	select PLAT_HAS_MALLOC
        select PLAT_TICKS
	select 16_BIT

config MSP430F5529
	bool
	select MSP430
	select PLAT_HAS_GPIO
	select PLAT_HAS_SERIAL
	select PLAT_HAS_SPI
	select PLAT_HAS_GPIO_INTERRUPTS
	select BUFFERED_SERIAL
```

## platform/unix/Kconfig
```kconfig
menu "Platform Emulation Options"

config PLATFORM_EMULATION_PTY_TERM
	bool "PTY Terminal"
	default y

config PLATFORM_EMULATION_BLOCK_DISK
	bool "Block Disk Emulation"
	default y
	select PLAT_HAS_BLK

config PLATFORM_EMULATION_BLOCK_DISK_PATH
	string "Block Disk Path"
	depends on PLATFORM_EMULATION_BLOCK_DISK
	default "/tmp/tp_block_disk.img"

config PLATFORM_EMULATION_BLOCK_DISK_NUM_SECTORS
	int "Block Disk Number of Sectors"
	depends on PLATFORM_EMULATION_BLOCK_DISK
	default 2048

config LINUX_ETH
	bool "Linux User Mode Ethernet using Packet Socket"
	depends on PLATFORM_EMULATION
	select ETHERIF
	default n
	help
		Packet sockets allow raw Ethernet packet send/receive
		Selecting this option requires running the process on Linux with
		root permissions

endmenu
```

## usb/Kconfig
```kconfig
menuconfig USB
	bool "USB Support"
	default y
        depends on PLAT_HAS_USB

if USB

config USB_DEVICE
	bool "USB Device Support"
	default y

config USB_CDC_ACM
	bool "USB CDC ACM Device Support"
        depends on USB_DEVICE
	default y

config USB_DEVICE_QUIRK_SET_ADDR_IMM
        bool

endif
```
