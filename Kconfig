## Kconfig
```kconfig
mainmenu "TinkerPal Configuration"

config TINKERPAL
	bool
	default y

source "boards/Kconfig"
source "apps/Kconfig"
source "js/Kconfig"
source "net/Kconfig"
source "usb/Kconfig"

config GRAPHICS
	bool "Graphics support"
	default y

source "drivers/Kconfig"
source "platform/Kconfig"
source "mem/Kconfig"
```

## apps/Kconfig
```kconfig
menu "Application"

config CLI
	bool

choice
	prompt "Application"

config APP_REPL
	bool "JavaScript Read Eval Print Loop (REPL) Application"
	depends on JS
	select CLI

config APP_ECHO_CONSOLE
	bool "Echo Command Line Interface (CLI) Application"
	select CLI

config APP_FILE_LOADER
	bool "Application accepting a source file via command line"
	depends on JS && VFS

config APP_STATIC_FILE
	bool "Static File Application"
	depends on JS

config APP_NET_TEST
	bool "Net test"
	depends on ETHERNET
	select CLI

config APP_GRAPHICS_TEST
	bool "Graphics test"
	depends on GRAPHICS
	select CLI

config APP_FAT_MMC_TEST
	bool "FAT over MMC test"
	depends on FAT_FS && MMC
	select CLI

config APP_BLINKY
	bool "Blink board LEDs"
	depends on GPIO

config APP_UNIT_TESTS
	bool "Unit Tests"
	select CLI

config APP_DUMMY
	bool "Dummy. Does nothing. Used for testing"

endchoice

config APP_STATIC_FILE_PATH
	string "Static File Path"
	depends on APP_STATIC_FILE

config CLI_BUFFER_SIZE
	int "CLI Buffer Size"
	depends on CLI
	default 512

config CLI_SYNTAX_HIGHLIGHTING
	bool "CLI Syntax highlighting"
	depends on CLI
	default y

endmenu
```

## boards/Kconfig
```kconfig
choice

prompt "Board"

config PLATFORM_EMULATION
	bool "Unix Platform Emulation"
	select UNIX
	select PLAT_HAS_SERIAL
	help
		Simulator using STDIO as console and PTY as UART
		Uses Posix API, tested on Linux & Cygwin

config EK_LM4F120XL
	bool "TI LM4F120XL (Stellaris Launchpad)"
	select LM4F120XL

config EK_LM3S6965
	bool "TI EK-LM3S6965"
	select LM3S6965

config RDK_IDM
	bool "TI RDK-IDM (LM3S6918)"
	select LM3S6918
	select ILI93XX_BITBANG

config EK_TM4C123GXL
	bool "TI EK-TM4C123GXL (Tiva C Launchpad)"
	select TM4C123G

config EK_TM4C1294XL
	bool "TI EK-TM4C1294XL (Tiva C Connected Launchpad)"
	select TM4C1294

config CC3200_LAUNCHXL
	bool "CC3200-LAUNCHXL (CC3200 Launchpad)"
	select CC3200

config STM32F3DISCOVERY
	bool "ST Micro STM32F3 Discovery board"
	select STM32F303XX

config STM32F4DISCOVERY
	bool "ST Micro STM32F4 Discovery board"
	select STM32F407XX

config STM32F429IDISCOVERY
	bool "ST Micro STM32F429I Discovery board"
	select STM32F429XX

config STM32_ARMJISHU_28
	bool "ARMJishu 28'' STM32F103RBT based board"
	select STM32F103RBT

config STM32_HY_24
	bool "HY 24'' STM32F103VET6 based board"
	select STM32F103VET6

config FRDM_KL25Z
	bool "Freescale FRDM-KL25Z"
	select FRDM

config MSP430F5529_EXP
	bool "TI MSP430F5529 Experimenter Board"
	select MSP430F5529

config MSP430F5529_LAUNCHPAD
	bool "TI MSP430F5529 Launchpad"
	select MSP430F5529

config X86_PLATFORM_EMULATION
	bool "X86 Platform Emulation"
	select X86
	select PLAT_HAS_SERIAL
	help
		Bare metal x86

endchoice
```

## drivers/Kconfig
```kconfig
menu "Drivers"

config SPI
	bool "SPI support"
	depends on PLAT_HAS_SPI
	default y

config GPIO
	bool "GPIO support"
	depends on PLAT_HAS_GPIO
	default y

config MMC
	bool "MMC over SPI support"
	depends on SPI && GPIO
	default y

config I2C
	bool "I2C support"
	depends on PLAT_HAS_I2C
	default y

source "drivers/fs/Kconfig"
source "drivers/lcd/Kconfig"

if NET
source "drivers/net/Kconfig"
endif

endmenu
```

## drivers/fs/Kconfig
```kconfig
menu "File Systems"

config FAT_FS
	bool "FAT support"
	depends on PLAT_HAS_BLK || MMC
	default y

config LOCAL_FS
	bool "Local file system"
	depends on UNIX
	default y
	help
		Local file system access.
		Only Unix for now.
	
config BUILTIN_FS
	bool "Builtin FS"
	default y

config BUILTIN_FS_EXTERNAL_PATH
	string "Builtin FS External Files Path"
	depends on BUILTIN_FS

endmenu
```

## drivers/graphics/Kconfig
```kconfig
menuconfig GRAPHICS_SCREENS
	bool "Graphics Screens Drivers"
	default y

if GRAPHICS_SCREENS

config TEXT_LCD
	bool "Support for Hitachi HD44780 like text LCD screens over GPIO"
	depends on GPIO && JS
	default y

config ILI93XX
	bool

config ILI93XX_BITBANG
	bool "Bitbang transport support for ILI93xx controllers"
	depends on ILI93XX
	default y

config ILI9320
	bool "Support for the ILI9320 LCD controller"
	depends on GPIO && GRAPHICS
	select ILI93XX
	help
		Access is via a 16 bit GPIO interface for data
config ILI9325
	bool "Support for the ILI9325 LCD controller"
	depends on GPIO && GRAPHICS
	default y if STM32_HY_24
	select ILI93XX
	help
		Access is via a 16 bit GPIO interface for data

config ILI9328
	bool "Support for the ILI9328 LCD controller"
	depends on GPIO && GRAPHICS
	default y if RDK_IDM
	select ILI93XX
	help
		Access is via a 16 bit GPIO interface for data

config DOGS102X6
	bool "Support for EA DOGS-102x6 LCD controllers"
	depends on GPIO && SPI && GRAPHICS
	default y if MSP430F5529_EXP

config SSD1306
	bool "Support for the SSD1306 OLED display controller (over I2C)"
	depends on GPIO && I2C && GRAPHICS

config SSD1329
	bool "Support for the SSD1329 OLED display controller (over SPI)"
	depends on GPIO && SPI && GRAPHICS
	default y if EK_LM3S6965

config PCD8544
	bool "Support for the PCD8544 LCD controller used in Nokia 5110 screens"
	depends on GPIO && SPI && GRAPHICS

config ST7735
	bool "Support for the ST7735 LCD controller"
	depends on GPIO && SPI && GRAPHICS
        default y

config ST7920
	bool "Support for the ST7920 LCD controller (Parallel connection)"
	depends on GPIO && GRAPHICS
        default n

config SDL_SCREEN
	bool "LCD emulation via the SDL library"
	depends on UNIX && GRAPHICS

endif
```

## drivers/lcd/Kconfig
```kconfig
menu "LCD"

config TEXT_LCD
	bool "Support for Hitachi HD44780 like text LCD screens over GPIO"
	depends on GPIO && JS
	default y

config ILI93XX
	bool

config ILI93XX_BITBANG
	bool "Bitbang transport support for ILI93xx controllers"
	depends on ILI93XX
	default y

config ILI9320
	bool "Support for the ILI9320 LCD controller"
	depends on GPIO && GRAPHICS
	select ILI93XX
	help
		Access is via a 16 bit GPIO interface for data
config ILI9325
	bool "Support for the ILI9325 LCD controller"
	depends on GPIO && GRAPHICS
	default y if STM32_HY_24
	select ILI93XX
	help
		Access is via a 16 bit GPIO interface for data

config ILI9328
	bool "Support for the ILI9328 LCD controller"
	depends on GPIO && GRAPHICS
	default y if RDK_IDM
	select ILI93XX
	help
		Access is via a 16 bit GPIO interface for data

config DOGS102X6
	bool "Support for EA DOGS-102x6 LCD controllers"
	depends on GPIO && SPI && GRAPHICS
	default y if MSP430F5529_EXP

config SDL_SCREEN
	bool "LCD emulation via the SDL library"
	depends on UNIX && GRAPHICS
	default y if PLATFORM_EMULATION

endmenu
```

## drivers/net/Kconfig
```kconfig
menu "Networking"

config ENC28J60
	bool "ENC28J60 SPI Ethernet Support"
	depends on SPI && GPIO
	select ETHERIF
	default y

config ENC28J60_PHY_ACCESS
	bool "ENC28J60 PHY Configuration Access"
	depends on ENC28J60
	default y
	help
		On some platforms, PHY access does not seem to work 
		(probably SPI timing issues). This allows disabling it

config ESP8266
	bool "ESP8266 Wi-Fi Support"
	depends on PLAT_HAS_SERIAL
	default y

endmenu
```

## js/Kconfig
```kconfig
menuconfig JS
	bool "JS support"
	default y

if JS

config JS_COMPILER
        bool "Run-time Compilation Support (Experimental)"
        depends on ARM
        default n

config MAX_FUNCTION_CALL_ARGS
	int "Maximum Number of Arguments Allowed on a Function Call"
	range 1 20
	default 11
	help
		In general there is no need to tinker with this value.
		Change it in case you need to send a large amount of 
		arguments to a function.

config OBJ_DOC
	bool "Provide object documentation at run time"
	default y if UNIX

source "js/builtins/Kconfig"
source "js/modules/Kconfig"

endif
```

## js/builtins/Kconfig
```kconfig
menu "Built-in Features"

config BUILTIN_GLOBALS
	bool "Global functions"
	default y

config BUILTIN_TIMERS
	bool "Timer functions"
	default y

config BUILTIN_MATH
	bool "Math functions"
	default y

endmenu
```

## js/modules/Kconfig
```kconfig
menuconfig MODULES
	bool "Modules support"
	depends on VFS
	default y

if MODULES

config MODULE_ASSERT
	bool "Assert module"
	default y

config MODULE_THERMAL_PRINTER
	bool "Thermal Printer module"
	default y
        help
                Module for a mini thermal printer (e.g. https://learn.adafruit.com/mini-thermal-receipt-printer/)

config MODULE_MAX7219
	bool "MAX7219 8-Digit LED Display Driver"

endif
```

## main/Kconfig
```kconfig
menu "Memory Allocation Tuning"

config PLAT_HAS_MALLOC
	bool

choice
	prompt "Memory allocation mode"
	default MALLOC

config MALLOC
	bool "Use libc malloc"
	depends on PLAT_HAS_MALLOC

config DLMALLOC
	bool "Use Doug Lea malloc"
	depends on !TI_CCS5

endchoice

config MEM_CACHE
	bool "Memory cache - pool memory resources"
	default y
	help
		Reduce allocation overhead by grouping similar objects 
		allocations.
		Note: on very small memory platforms (~8KB), the cache overhead
		is larger than the allocation overhead.
		When not enabled, the mem_cache API reduces to standard allocation
		If in doubt, say y

config MEM_PROFILING
	bool "Allow profiling of used memory"
	help
		In order to profile memory use, additional space is allocated 
		on each request in order to keep track of allocated memory.
		This is used by OBJ_REGISTRY and MEM_ALLOCATION_LIMIT
		If in doubt, say n

config DLMALLOC_STATISTICS
	bool "dlmalloc Statistics"
	depends on DLMALLOC && MEM_PROFILING
	default y if PLATFORM_EMULATION

config OBJ_REGISTRY
	bool "Object Registry Records"
	depends on MEM_PROFILING
	default y if PLATFORM_EMULATION

config MEM_ALLOCATION_LIMIT
	bool "Limit amount of allocated memory"
	depends on MEM_PROFILING

config MEM_ALLOCATION_LIMIT_BYTES
	int "Maximum number of allocated bytes"
	depends on MEM_ALLOCATION_LIMIT
	default 32768

endmenu
```

## net/Kconfig
```kconfig
menuconfig NET
	bool "Networking Support"
	default y

if NET

config ETHERIF
	bool
	select ETHERNET
	default n

config PACKET
	bool
	default n

config ETHERNET
	bool "Ethernet"
	select PACKET
        depends on ETHERIF
	default y
	help
		Support for Ethernet protocols handling

config ARP
	bool "ARP"
	depends on ETHERNET
	default y
	help
		Support for the Address Resolution Protocol (ARP)

config IPV4
	bool "IPv4"
	depends on ETHERNET
	default y
	help
		Support for IPv4

config ICMP
	bool "ICMP"
	depends on IPV4
	default y
	help
		Support for ICMP

config UDP
	bool "UDP"
	depends on IPV4
	default y
	help
		Support for UDP

config DHCP_CLIENT
	bool "DHCP Client"
	depends on UDP
	default y
	help
		Support for obtaining an IP address using Dynamic Host
		Configuration Protocol (DHCP)

config NET_DEBUG
	bool "Network Debugging"
	default n

endif
```

## platform/Kconfig
```kconfig
menu "Platform"

config PLAT_HAS_GPIO
	bool

config PLAT_HAS_GPIO_INTERRUPTS
	bool

config PLAT_HAS_SERIAL
	bool

config PLAT_HAS_SPI
	bool

config PLAT_HAS_I2C
	bool

config PLAT_HAS_EMBEDDED_ETH
	bool

config PLAT_HAS_PWM
	bool

config BUFFERED_SERIAL
	bool
	depends on PLAT_HAS_SERIAL

config PLAT_HAS_BLK
	bool

config PLAT_HAS_USB
	bool

config 16_BIT
	bool

config PLAT_TICKS
        bool

source "platform/arm/Kconfig"
source "platform/msp430/Kconfig"
source "platform/unix/Kconfig"
source "platform/x86/Kconfig"
source "platform/avr8/Kconfig"
source "platform/esp8266/Kconfig"

source "platform/Kconfig.toolchain"

endmenu
```

## platform/Kconfig.toolchain
```kconfig
config PLAT_HAS_GCC
	bool

config PLAT_HAS_TI_CCS5
	bool

choice
	prompt "Toolchain"
	default GCC

config GCC
	bool "GCC"
	depends on PLAT_HAS_GCC

config TI_CCS5
	bool "TI Code Composer Studio 5"
	depends on PLAT_HAS_TI_CCS5

endchoice

if GCC

config GCC_LTO
	bool "GCC Link Time Optimization"

config GCC_GCOV
	bool "GCC Coverage Data Generation"

config GCC_CAST_QUAL
	bool "GCC warn on qualifier removal by cast"

endif
```
